## main/Kconfig.projbuild
```kconfig
menu "LED Controller Configuration"

    config WIFI_SSID
        string "WiFi SSID"
        default "myssid"
        help
            SSID of the network the ESP32 should connect to.

    config WIFI_PASSWORD
        string "WiFi Password"
        default "mypassword"
        help
            WPA2 password for the above network.

    config FIREBASE_DATABASE_URL
        string "Firebase Realtime Database URL (led.json path)"
        default "https://your-project-default-rtdb.firebaseio.com/led.json"
        help
            Full REST URL including the /led.json path, e.g.
            https://your-project-default-rtdb.europe-west1.firebasedatabase.app/led.json

endmenu
```
